## zmk-config-dactyl_manuform/config/boards/shields/dactyl_manuform/Kconfig.defconfig
```kconfig
if SHIELD_DACTYL_MANUFORM_LEFT

config ZMK_KEYBOARD_NAME
    default "Dactyl Manuform"

config ZMK_SPLIT_ROLE_CENTRAL
    default y

endif

if SHIELD_DACTYL_MANUFORM_LEFT || SHIELD_DACTYL_MANUFORM_RIGHT

config ZMK_SPLIT
    default y

endif
```

## zmk-config-dactyl_manuform/config/boards/shields/dactyl_manuform/Kconfig.shield
```kconfig
config SHIELD_DACTYL_MANUFORM_LEFT
    def_bool $(shields_list_contains,dactyl_manuform_left)
    select SPI

config SHIELD_DACTYL_MANUFORM_RIGHT
    def_bool $(shields_list_contains,dactyl_manuform_right)
    select SPI
```

## zmk-config-dactyl_manuform/config/boards/shields/dactyl_manuform/boards/seeeduino_xiao_ble.conf
```kconfig
# https://github.com/petejohanson/revxlp-config/blob/main/config/boards/shields/revxlp/boards/seeeduino_xiao_ble.conf
CONFIG_SPI=y
```
