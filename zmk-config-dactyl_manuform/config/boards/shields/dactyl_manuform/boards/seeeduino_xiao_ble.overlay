// https://github.com/petejohanson/revxlp-config/blob/main/config/boards/shields/revxlp/boards/seeeduino_xiao_ble.overlay
// What does NRF_PSEL mean (https://docs.zephyrproject.org/apidoc/latest/nrf-pinctrl_8h.html)?
// It assigns a function to a pin of the nRF-Chip. In this case here SCK and MOSI are assigned to the corresponding pins
// which can be found e. g. in the schematic:
// https://files.seeedstudio.com/wiki/XIAO-BLE/Seeed-Studio-XIAO-nRF52840-Sense-v1.1.pdf

&spi2_default {
	group1 {
		psels = <NRF_PSEL(SPIM_SCK, 1, 13)>,
			<NRF_PSEL(SPIM_MOSI, 1, 15)>;
	};
};

&spi2_sleep {
	group1 {
		psels = <NRF_PSEL(SPIM_SCK, 1, 13)>,
			<NRF_PSEL(SPIM_MOSI, 1, 15)>;
	};
};
